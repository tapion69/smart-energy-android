## firmware/vpn-gateway/main/Kconfig.projbuild
```kconfig
menu "Smart Energy VPN Gateway — test only"
    config SE_JK_IP
        string "JK ESP32 private LAN IPv4 address"
        default ""
        help
            E.g. 192.168.1.53. Empty disables JK forwarding.
    config SE_JK_READ_CODE
        string "JK ESP32 access code (NEVER commit)"
        default ""
        help
            X-Setup-Code for the JK ESP32 on the trusted LAN only.
    config SE_JK2_IP
        string "JK ESP32 reader 2 private LAN IPv4"
        default ""
        help
            Empty disables second JK reader VPN forwarding.
    config SE_JK2_READ_CODE
        string "JK ESP32 reader 2 access code (NEVER commit)"
        default ""
    config SE_JK3_IP
        string "JK ESP32 reader 3 private LAN IPv4"
        default ""
        help
            Empty disables third JK reader VPN forwarding.
    config SE_JK3_READ_CODE
        string "JK ESP32 reader 3 access code (NEVER commit)"
        default ""
    config SE_VOLT_IP
        string "Voltronic ESP LAN IPv4 (optional, experimental)"
        default ""
    config SE_VOLT_READ_PATH
        string "Voltronic read-only JSON route (optional)"
        default ""
        help
            E.g. /api/v1/telemetry only once independently verified.
            Empty disables Voltronic forwarding completely.
    config SE_VOLT_READ_CODE
        string "Voltronic optional read code (never commit)"
        default ""
    config SE_GATEWAY_TOKEN
        string "Independent strong gateway read token"
        default ""
        help
            At least 20 characters. Set locally, never in source control.
            Used in X-Gateway-Token from the Android/PC test client.
endmenu
```

## firmware/vpn-gateway/sdkconfig.defaults
```kconfig
# Minimum experimental footprint for a classic ESP32 (4 MB flash).
# TailTiny 3.1.0 requires ESP-IDF >= 5.3.
CONFIG_LWIP_MAX_SOCKETS=16
CONFIG_LWIP_SO_RCVBUF=y
CONFIG_LWIP_TCPIP_RECVMBOX_SIZE=32
CONFIG_MBEDTLS_CHACHA20_C=y
CONFIG_MBEDTLS_POLY1305_C=y
CONFIG_MBEDTLS_CHACHAPOLY_C=y
CONFIG_MBEDTLS_HKDF_C=y
CONFIG_MBEDTLS_SSL_PROTO_TLS1_2=y
CONFIG_MBEDTLS_DYNAMIC_BUFFER=y
CONFIG_MBEDTLS_CERTIFICATE_BUNDLE=y
CONFIG_ML_DERP_VERIFY_CERT=y
CONFIG_FREERTOS_HZ=1000
CONFIG_FREERTOS_TIMER_TASK_STACK_DEPTH=4096
CONFIG_ESP_TASK_WDT_TIMEOUT_S=30
CONFIG_ESP_WIFI_AMPDU_TX_ENABLED=n
CONFIG_ESP_WIFI_AMPDU_RX_ENABLED=n
CONFIG_PARTITION_TABLE_SINGLE_APP_LARGE=y
CONFIG_LOG_DEFAULT_LEVEL_INFO=y
CONFIG_ML_MAX_PEERS=32
CONFIG_ML_NVS_MAX_PEERS=16
CONFIG_ML_H2_BUFFER_SIZE_KB=80
CONFIG_ML_JSON_BUFFER_SIZE_KB=64
CONFIG_ML_ENABLE_CONFIG_HTTPD=n
```
